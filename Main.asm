; Код для модуля управления звуком для магнитолы Sony ZS-S50CP
; на основе микроконтроллера Atmel ATtiny13
; Функция - прием команд управления звуком от главного контроллера (MCU) магнитолы, 
; их необходимое преобразование и передача на ИС управления звуком (ASP) RS15904SP
; Цель разработки: 
; - увеличение значений подъема АЧХ на верхах и низах в командах управления 
;   эквалайзером по сравнению со значениями, используемыми в магнитоле в стандарте
; - управление питанием звукового модуля bluetooth KRC-86B
; 
; А.В.Кабаев, 29.11.2007
; Дата последней модификации 25.01.2018


; значения FUSE-битов при прошивке ATtiny13
; hFuse: 0xFF, lFuse: 0x76
; конфигурация
; CKDIV8 - 1 (предделитель тактовой частоты отключен)
; SUT1/0 - 01 (время старта после сброса - 14CK + 4 мс)
; CKSEL1/0 - 10 (внутреннее тактирование на 9.6 МГц)


; распиновка
; входы:  PB0 - SDA, PB1 - SCK
; выходы: PB4 - SDA, PB3 - SCK
;         PB2 - управление питанием bluetooth модуля (0 - выкл., 1 - вкл.)

; использование регистров
; r1/r0 - буфер для принимаемой команды
; r21/r20 - буфер для передаваемой команды
; r16 - счетчик принимаемых битов
; r17 - счетчик передаваемых битов
; r18 - флаг принятой команды
; r19 - служебный регистр
; r22 - регистр для хранения SREG в прерывании
; r23 - регистр для приема битов
; r25/r24 - счетчик таймаута приема команды


.include "tn13def.inc"


.cseg

.org 0
	rjmp main

;
; обработчик прерывания INT0 
; выполняет прием очередного бита команды от MCU c линии SDA (PB0)
; по стробу на линии SCK (PB1) во входной буфер (r1/r0)
; после приема всех 16 битов копирует команду в выходной буфер (r21/r20)
; и устанавливает флаг наличия команды
;
.org INT0addr

	in r23, PINB		; получаем значение битов с PB

	in r22, SREG		; сохраняем состояние флагов

	ror r23				; выдвигаем PB0 в C
	rol r0				; и вдвигаем в мл.разряд регистр.пары r1-r0
	rol r1

	dec r16
	brne int_ret		; если это не последний бит, выходим из прерывания
	
	tst r18				; проверяем наличие предыдущей команды в вых. буфере
	brne cmd_drop		; если есть, принятую отбрасываем
	
	movw r20, r0		; копируем принятую команду в выходной буфер
	ser r18				; устанавливаем флаг наличия команды

cmd_drop:
	ldi r16, 16			; переинициализируем счетчик битов

int_ret:
	out SREG, r22		; восстанавливаем состояние флагов
	reti				; выходим из прерывания


;
; основная программа
;
main:
	rcall init		; инициализируем периферию

init_recv:
	cli				; запрещаем прерывания
	ldi r16, 16		; инициализируем счетчик битов и флаг принятой команды
	clr r18
	sei				; разрешаем прерывания
	
init_wait:	
	ldi r25, 32		; устанавливаем счетчик таймаута команды
	ldi r24, 0 

cmd_wait:
	tst r18				; проверяем флаг окончания приема команды
	brne cmd_process 	; если не 0, переходим на обработку

	cpi r16, 16		; проверяем прием части битов команды
	breq cmd_wait	; ни один бит не принят, продолжаем ждать
	
	; часть команды принята, проверка таймаута
    sbiw r24, 1		; уменьшаем счетчик ожидания команды
	brne cmd_wait	; еще не обнулился, продолжаем ждать
	
	; таймаут принятия команды
	; проверяем переход в режим STANDBY (постоянный высокий уровень на SDA и SCK)
	in r23, PINB	; получаем значение битов с PB
	andi r23, 3		; выделяем биты 0 и 1 (SDA, SCK)
	cpi r23, 3		; оба бита = 1 ?
	brne init_recv	; нет, переходим на переинициализацию приема
	
	; включен режим STANDBY
	cbi PORTB, PORTB2	; ВЫКЛючаем питание Bluetooth Audio модуля
	rjmp init_recv	; переходим на переинициализацию приема
	
cmd_process:	
	; команда принята в r21/r20
	; выполняем ее проверку и необходимую корректировку

	cpi r21, 0xB5	; проверка команды подъема +6 по верхам и низам
	brne check_next1
	cpi r20, 0x81
	brne check_next1
	
	ldi r21, 0xFF	; подменяем ее на +15 по низам и +13 по верхам
	ldi r20, 0x41
	rjmp cmd_send

check_next1:
	cpi r21, 0x05	; проверка команды подъема +6 по верхам
	brne check_next2
	cpi r20, 0x81
	brne check_next2
	
	ldi r21, 0x07	; подменяем ее на +13 по верхам
	ldi r20, 0x41
	rjmp cmd_send

check_next2:
	cpi r21, 0xB0	; проверка команды подъема +6 по низам
	brne check_next3
	cpi r20, 0x01
	brne check_next3
	
	ldi r21, 0xF8	; подменяем ее на +15 по низам
	ldi r20, 0x01
	rjmp cmd_send
	
check_next3:
	cpi r21, 0xE6		; проверка команды подключения входа Audio IN
	brne check_next4
	cpi r20, 0x00
	brne check_next4
	
	sbi PORTB, PORTB2	; ВКЛючаем питание Bluetooth Audio модуля
	rjmp cmd_send

check_next4:
	cpi r21, 0x26		; проверка команды подключения входа CD
	brne check_next5
	cpi r20, 0x00
	brne check_next5
	
	cbi PORTB, PORTB2	; ВЫКЛючаем питание Bluetooth Audio модуля
	rjmp cmd_send
	
check_next5:
	cpi r21, 0xEE		; проверка команды подключения входа Radio
	brne cmd_send
	cpi r20, 0x00
	brne cmd_send
	
	cbi PORTB, PORTB2	; ВЫКЛючаем питание Bluetooth Audio модуля
	
cmd_send:
	; подготовка к передаче команды
	
    ldi r17, 16			; инициализируем счетчик битов

	clr r19				; сбрасываем таймер
	out TCNT0, r19
	
	ldi r19, 1<<OCF0A	; и признак его переполнения
	out TIFR0, r19

bit_send:
	; передача битов команды

	cbi PORTB, PORTB3	; 0 -> SCK(PB3)

	cbi PORTB, PORTB4	; выставляем очередной бит на SDA (PB4)
	sbrc r21, 7
	sbi PORTB, PORTB4
	
	rcall pause_05		; пауза пол-такта
	
	sbi PORTB, PORTB3	; 1 -> SCK(PB3)
	rcall pause_05		; пауза пол-такта

	rol r20				; сдвигаем биты команды влево
	rol r21

	dec r17
	brne bit_send		; все биты переданы?

	clr r18				; сбрасываем флаг наличия команды
	
	
	; передача стопового бита
	
	sbi PORTB, PORTB4	; 1 -> SDA
	rcall pause_05		; пауза пол-такта
	cbi PORTB, PORTB3	; 0 -> SCK
	rcall pause_05		; пауза 1 такт
	rcall pause_05		
	cbi PORTB, PORTB4	; 0 -> SDA
	
	rjmp init_wait		; на ожидание следующей команды
	

;
; подпрограмма задержки на 1 период работы таймера
; выполняет ожидание установки флага переполнения таймера OCF0A
; и его сброс
;
pause_05:

	in r19, TIFR0		; ждем установки бита OCF0A
	sbrs r19, OCF0A
	rjmp pause_05

	ldi r19, 1<<OCF0A	; бит установлен, сбрасываем его
	out TIFR0, r19

	ret


;
; подпрограмма инициализации микроконтроллера
;
init:
	; повышение до максимума тактовой частоты внутр.генератора (~15 МГц)
	; ldi r19, 0x7f
	; out OSCCAL, r19

	; настройка порта: PB0, PB1 - входы, PB2, PB3, PB4 - выходы
	ldi r19, (1<<DDB2) | (1<<DDB3) | (1<<DDB4)
	out DDRB, r19
	cbi PORTB, PORTB2	; питание Bluetooth Audio модуля выключено

	; установка режима Idle для SLEEP и 
	; прерывания по нарастающему фронту на INT0
	ldi r19, (1<<SE) | (1<<ISC00) | (1<<ISC01)
	out MCUCR, r19                             

	; разрешение прерывания INT0
	ldi r19, 1<<INT0
	out GIMSK, r19
	 
	; режим таймера - CTC (счет до константы с обнулением)
	ldi r19, 1<<WGM01
	out TCCR0A, r19

	; тактирование таймера системным клоком без деления
	ldi r19, 1<<CS00
	out TCCR0B, r19

	; константа для таймера для получения частоты ~280 кГц
	; (удвоенная частота передачи выходных сигналов)
	ldi r19, 34
	out OCR0A, r19

	ret

Signature: .DB "Sony ZS-S50CP Sound Control Command Converter"
