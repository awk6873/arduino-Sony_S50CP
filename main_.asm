; Код для модуля управления звуком для магнитолы Sony ZS-S50CP
; на основе микроконтроллера Atmel ATtiny13
; Функция - прием команд управления звуком от главного контроллера (MCU) магнитолы, 
; их необходимое преобразование и передача на ИС управления звуком (ASP) RS15904SP
; Цель разработки - увеличение значений подъема АЧХ на верхах и низах 
; в командах управления эквалайзером по сравнению со значениями, используемыми 
; в магнитоле в стандарте
; 
; А.В.Кабаев, 29.11.2007
; Дата последней модификации 10.12.2007


; значения FUSE-битов при прошивке ATtiny13
; CKDIV8 - 1 (предделитель тактвой частоты отключен)
; SUT1/0 - 01 (время старта после сброса - 14CK + 4 мс)
; CKSEL1/0 - 10 (внутреннее тактирование на 9.6 МГц)


; использование регистров
; r1/r0 - буфер для принимаемой команды
; r21/r20 - буфер для передаваемой команды
; r16 - счетчик принимаемых битов
; r17 - счетчик передаваемых битов
; r18 - флаг принятой команды
; r19 - служебный регистр
; r22 - регистр для хранения SREG в прерывании


.include <tn13def.inc>


.cseg

.org 0
	rjmp main

;
; обработчик прерывания по изменению уровня на PB1
; выполняет прием очередного бита команды от MCU c линии SDA (PB1)
; по стробу на линии SCK (PB0) во входной буфер (r1/r0)
; после приема всех 16 битов копирует команду в выходной буфер (r21/r20)
; и устанавливает флаг наличия команды
;
.org PCI0addr

	sbi PORTB, PORTB2

	sbis PINB, PINB0	; обрабатываем только прерывания по нарастающему фронту
	reti

	in r22, SREG		; сохраняем состояние флагов

	clc					; получаем значение бита с PB1 в C
	sbic PINB, PINB1
	sec

	rol r0				; вдвигаем C в мл.разряд регистр.пары r1-r0
	rol r1

	dec r16
	breq cmd_save		; если это 16-й бит, команда принята
	
	out SREG, r22		; иначе восстанавливаем состояние и
	reti				; выходим из прерывания

cmd_save:
	movw r20, r0		; принята вся команда, копируем ее в выходной буфер
	ser r18				; устанавливаем флаг наличия команды
		
	ldi r16, 16			; переинициализируем счетчик битов

	out SREG, r22		; восстанавливаем состояние флагов
	reti				; возврат


;
; основная программа
;
main:
	rcall init		; инициализируем периферию

	ldi r16, 16		; инициализируем счетчик битов и флаг принятой команды
	clr r18

	sei				; разрешаем прерывания

go_sleep:
	sleep 			; переходим в режим Power-done

	; проснулись из-за прерывания

flag_wait:
	tst r18			; ждем окончания приема всей команды
	breq flag_wait

	; команда принята в r21/r20
	; выполняем ее проверку и необходимую корректировку

	cpi r21, 0xB5	; проверка команды подъема +6 по верхам и низам
	brne check_next1
	cpi r20, 0x81
	brne check_next1
	
	ldi r21, 0xFF	; подменяем ее на +15 по низам и +12 по верхам
	ldi r20, 0x01
	rjmp cmd_send

check_next1:
	cpi r21, 0x05	; проверка команды подъема +6 по верхам
	brne check_next2
	cpi r20, 0x81
	brne check_next2
	
	ldi r21, 0x07	; подменяем ее на +12 по верхам
	ldi r20, 0x01
	rjmp cmd_send

check_next2:
	cpi r21, 0xB0	; проверка команды подъема +6 по низам
	brne cmd_send
	cpi r20, 0x01
	brne cmd_send
	
	ldi r21, 0xF8	; подменяем ее на +15 по низам
	ldi r20, 0x01

cmd_send:
	; подготовка к передаче команды
	
    ldi r17, 16			; инициализируем счетчик битов

	clr r19				; сбрасываем таймер
	out TCNT0, r19
	
	ldi r19, 1<<OCF0A	; и признак его переполнения
	out TIFR0, r19

bit_send:
	; передача битов команды

	cbi PORTB, PORTB2	; 0 -> SCK(PB2)

	cbi PORTB, PORTB4	; выставляем очередной бит на SDA (PB4)
	sbrc r21, 7
	sbi PORTB, PORTB4
	
	rcall pause_05		; пауза пол-такта
	
	sbi PORTB, PORTB2	; 1 -> SCK(PB2)
	rcall pause_05		; пауза пол-такта

	rol r20				; сдвигаем биты команды влево
	rol r21

	dec r17
	brne bit_send		; все биты переданы?

	clr r18				; сбрасываем флаг наличия команды
	
	
	; передача стопового бита
	
	sbi PORTB, PORTB4	; 1 -> SDA
	rcall pause_05		; пауза пол-такта
	cbi PORTB, PORTB2	; 0 -> SCK
	rcall pause_05		; пауза пол-такта
	cbi PORTB, PORTB4	; 0 -> SDA
		
	rjmp go_sleep

;
; подпрограмма задержки на 1 период работы таймера
; выполняет ожидание установки флага переполнения таймера OCF0A
; и его сброс
;
pause_05:

	in r19, TIFR0		; ждем установки бита OCF0A
	sbrs r19, OCF0A
	rjmp pause_05

	ldi r19, 1<<OCF0A	; бит установлен, сбрасываем его
	out TIFR0, r19

	ret


;
; подпрограмма инициализации микроконтроллера
;
init:
	; повышение до максимума тактовой частоты внутр.генератора
	ldi r19, 0x7f
	out OSCCAL, r19

	; настройка порта: PB0, PB1 - входы, PB2, PB4 - выходы
	ldi r19, (1<<DDB2) | (1<<DDB4)
	out DDRB, r19

	; установка режима Power-down для SLEEP 
	ldi r19, (1<<SE) | (1<<SM1)
	out MCUCR, r19                             

	; разрешение прерывания от изменения уровня на PB0
	ldi r19, 1<<PCINT0
	out PCMSK, r19
	ldi r19, 1<<PCIE
	out GIMSK, r19
	 
	; режим таймера - CTC (счет до константы с обнулением)
	ldi r19, 1<<WGM01
	out TCCR0A, r19

	; тактирование таймера системным клоком без деления
	ldi r19, 1<<CS00
	out TCCR0B, r19

	; константа для таймера для получения частоты ~400 кГц
	; (удвоенная частота передачи выходных сигналов)
	ldi r19, 37
	out OCR0A, r19

	ret

Signature: .DB "Sony ZS-S50CP Sound Control Command Converter"
